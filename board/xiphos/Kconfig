## board/xiphos/Kconfig
```kconfig
# Copyright (c) 2018, Xiphos System Corp.
#
# SPDX-License-Identifier: GPL-2.0

if SYS_VENDOR = "xiphos"
config XIPHOS_DEFAULTS
	bool "Xiphos default configurations"
	default y
	select CMD_XSCINFO
	select CMD_PA3
	select CMD_UBI
	select CMD_UBIFS
endif

if SYS_BOARD = "q7"
config XSC_ROOTFS_NOM0_ID
	string "Partition ID for nominal 0 rootfs"
	default 11

config XSC_ROOTFS_GOLD0_ID
	string "Partition ID for gold 0 rootfs"
	default 21

config XSC_ROOTFS_NOM1_ID
	string "Partition ID for nominal 1 rootfs"
	default 32

config XSC_ROOTFS_GOLD1_ID
	string "Partition ID for gold 1 rootfs"
	default 42
endif
```

## configs/xiphos_q7_defconfig
```kconfig
CONFIG_ARM=y
CONFIG_SYS_VENDOR="xiphos"
CONFIG_SYS_BOARD="q7"
CONFIG_SYS_CONFIG_NAME="xiphos_q7"
CONFIG_ARCH_ZYNQ=y
CONFIG_SYS_TEXT_BASE=0x4000000
CONFIG_DEFAULT_DEVICE_TREE="xiphos-q7-revb"
CONFIG_BOOTDELAY=1
# CONFIG_DISPLAY_CPUINFO is not set
CONFIG_HUSH_PARSER=y
CONFIG_SYS_PROMPT="xsc-q7> "
CONFIG_CMD_GREPENV=y
CONFIG_CMD_MEMINFO=y
# CONFIG_CMD_FLASH is not set
CONFIG_CMD_GPIO=y
CONFIG_CMD_MMC=y
CONFIG_CMD_PA3=y
CONFIG_CMD_XSCINFO=y
CONFIG_XSCINFO_ENABLE_RO_WRITE=y
CONFIG_CMD_SF=y
CONFIG_CMD_USB=y
CONFIG_CMD_TFTPPUT=y
CONFIG_CMD_DHCP=y
CONFIG_CMD_MII=y
CONFIG_CMD_PING=y
CONFIG_CMD_CACHE=y
CONFIG_CMD_EXT2=y
CONFIG_CMD_EXT4=y
CONFIG_CMD_EXT4_WRITE=y
CONFIG_CMD_FAT=y
CONFIG_CMD_FS_GENERIC=y
CONFIG_MTDIDS_DEFAULT="nor0=flash"
CONFIG_MTDPARTS_DEFAULT="mtdparts=flash:128k(qspi0-nom-xscinfo),10m(qspi0-nom-fw),54m(qspi0-nom-rootfs),128k(qspi0-gold-xscinfo),10m(qspi0-gold-fw),-(qspi0-gold-rootfs)"
CONFIG_CMD_UBI=y
CONFIG_OF_EMBED=y
CONFIG_NET_RANDOM_ETHADDR=y
CONFIG_SPL_DM_SEQ_ALIAS=y
CONFIG_DM_GPIO=y
CONFIG_MMC_SDHCI=y
CONFIG_SPI_FLASH=y
CONFIG_SPI_FLASH_BAR=y
CONFIG_SPI_FLASH_SPANSION=y
CONFIG_SPI_FLASH_STMICRO=y
CONFIG_SPI_FLASH_WINBOND=y
CONFIG_SPI_FLASH_MTD=y
CONFIG_ZYNQ_GEM=y
CONFIG_ZYNQ_SERIAL=y
CONFIG_ZYNQ_QSPI=y
CONFIG_USB=y
CONFIG_USB_EHCI_HCD=y
CONFIG_USB_ULPI_VIEWPORT=y
CONFIG_USB_ULPI=y
CONFIG_USB_STORAGE=y
CONFIG_USB_GADGET=y
CONFIG_CI_UDC=y
CONFIG_USB_GADGET_DOWNLOAD=y
```

## configs/zynq_q7_defconfig
```kconfig
CONFIG_ARM=y
CONFIG_ARCH_ZYNQ=y
CONFIG_TARGET_ZYNQ_Q7=y
CONFIG_DEFAULT_DEVICE_TREE="zynq-q7"
# CONFIG_SPL is not set
# CONFIG_FIT is not set
# CONFIG_FIT_VERBOSE is not set
CONFIG_FIT_SIGNATURE=y
CONFIG_SYS_PROMPT="xsc-q7> "
# CONFIG_CMD_IMLS is not set
# CONFIG_CMD_FLASH is not set
CONFIG_CMD_GPIO=y
CONFIG_CMD_SETEXPR=y
CONFIG_OF_EMBED=y
CONFIG_NET_RANDOM_ETHADDR=y
CONFIG_SPL_DM_SEQ_ALIAS=y
CONFIG_SPI_FLASH=y
CONFIG_SPI_FLASH_BAR=y
CONFIG_SPI_FLASH_SPANSION=y
CONFIG_SPI_FLASH_STMICRO=y
CONFIG_SPI_FLASH_WINBOND=y
CONFIG_ZYNQ_GEM=y
CONFIG_ZYNQ_QSPI=y
CONFIG_ENV_IS_IN_FLASH=y
CONFIG_ENV_IS_IN_SPI_FLASH=y
CONFIG_SYS_NO_FLASH=y
```
